## sdkconfig.defaults
```kconfig
# TianShanOS SDK Configuration
# ESP32 机架管理操作系统配置

# 目标芯片（默认 ESP32S3）
CONFIG_IDF_TARGET="esp32s3"

# CPU 频率 (240 MHz 最高性能)
CONFIG_ESP_DEFAULT_CPU_FREQ_MHZ_240=y
CONFIG_ESP_DEFAULT_CPU_FREQ_MHZ=240

# 分区表
CONFIG_PARTITION_TABLE_CUSTOM=y
CONFIG_PARTITION_TABLE_CUSTOM_FILENAME="partitions.csv"

# Flash 配置 (16MB)
CONFIG_ESPTOOLPY_FLASHSIZE_16MB=y
CONFIG_ESPTOOLPY_FLASHMODE_QIO=y
CONFIG_ESPTOOLPY_FLASHFREQ_80M=y

# PSRAM 配置（如果有）
CONFIG_SPIRAM=y
CONFIG_SPIRAM_MODE_OCT=y
CONFIG_SPIRAM_SPEED_80M=y

# FreeRTOS 配置
CONFIG_FREERTOS_HZ=1000
CONFIG_FREERTOS_USE_TRACE_FACILITY=y
CONFIG_FREERTOS_GENERATE_RUN_TIME_STATS=y
CONFIG_FREERTOS_TIMER_TASK_STACK_DEPTH=4096

# 日志配置
CONFIG_LOG_DEFAULT_LEVEL_INFO=y
CONFIG_LOG_MAXIMUM_LEVEL_DEBUG=y

# ============================================================================
# NVS 安全配置
# ============================================================================
# 安全等级：
#   L1（开发）: CONFIG_NVS_ENCRYPTION=n
#   L2（预生产）: CONFIG_NVS_ENCRYPTION=y + HMAC 方案
#   L3（生产）: CONFIG_NVS_ENCRYPTION=y + Flash Encryption
#
# HMAC 方案说明：
#   - 使用 eFuse HMAC 密钥派生 NVS 加密密钥
#   - 无需启用 Flash 加密即可保护 NVS 数据
#   - 首次启动会自动在 eFuse BLOCK4 生成 HMAC 密钥
#   - 启用后旧的 NVS 数据将丢失，需要重新配置
#
# 生产环境还应启用：
#   CONFIG_SECURE_BOOT=y
#   CONFIG_FLASH_ENCRYPTION_ENABLED=y
#   CONFIG_SECURE_BOOT_DISABLE_JTAG=y
# ============================================================================

# === L2 NVS 加密配置（HMAC 方案）===
# 取消注释以下行以启用 NVS 加密
#CONFIG_NVS_ENCRYPTION=y
#CONFIG_NVS_SEC_KEY_PROTECTION_SCHEME=1
#CONFIG_NVS_SEC_KEY_PROTECT_USING_HMAC=y
#CONFIG_NVS_SEC_HMAC_EFUSE_KEY_ID=4

# 当前：L1 开发模式（NVS 不加密）
CONFIG_NVS_ENCRYPTION=n

# WiFi 配置
CONFIG_ESP_WIFI_STATIC_RX_BUFFER_NUM=10
CONFIG_ESP_WIFI_DYNAMIC_RX_BUFFER_NUM=32
CONFIG_ESP_WIFI_DYNAMIC_TX_BUFFER_NUM=32

# 以太网配置（W5500 SPI）
CONFIG_ETH_SPI_ETHERNET_W5500=y
CONFIG_ETH_SPI_ETHERNET_DM9051=n
CONFIG_ETH_SPI_ETHERNET_KSZ8851SNL=n

# 看门狗配置
CONFIG_ESP_TASK_WDT_TIMEOUT_S=30
CONFIG_ESP_TASK_WDT_CHECK_IDLE_TASK_CPU0=y
CONFIG_ESP_TASK_WDT_CHECK_IDLE_TASK_CPU1=y

# HTTP 服务器 WebSocket 支持
CONFIG_HTTPD_WS_SUPPORT=y

# OTA 配置（允许 HTTP 用于开发环境）
CONFIG_ESP_HTTPS_OTA_ALLOW_HTTP=y

# LWIP NAT 配置（WiFi STA -> ETH 网关）
CONFIG_LWIP_IP_FORWARD=y
CONFIG_LWIP_IPV4_NAPT=y
CONFIG_LWIP_NAPT_MAX_TCP=16
CONFIG_LWIP_NAPT_MAX_PORTMAP=8

# LWIP Socket 配置（增加限制以支持多连接）
CONFIG_LWIP_MAX_SOCKETS=16

# 系统事件任务栈大小（默认太小，增加到 4096）
CONFIG_ESP_SYSTEM_EVENT_TASK_STACK_SIZE=4096

# 堆调试（开发期间）
CONFIG_HEAP_TRACING_OFF=y

# SD 卡 SDIO 配置 (RM01 GPIO - 与 robOS 一致)
# 引脚: CMD=4, CLK=5, D0=6, D1=7, D2=15, D3=16
# 频率: 40MHz 高速模式
CONFIG_TS_STORAGE_SD_MODE_SDIO_4BIT=y
CONFIG_TS_STORAGE_SD_CMD_GPIO=15
CONFIG_TS_STORAGE_SD_CLK_GPIO=16
CONFIG_TS_STORAGE_SD_D0_GPIO=4
CONFIG_TS_STORAGE_SD_D1_GPIO=5
CONFIG_TS_STORAGE_SD_D2_GPIO=6
CONFIG_TS_STORAGE_SD_D3_GPIO=7

# FATFS 长文件名支持 (>8.3 格式)
CONFIG_FATFS_LFN_HEAP=y
CONFIG_FATFS_MAX_LFN=255

# VFS 和 FATFS 卷配置
# VFS_MAX_COUNT 必须足够大以支持 SD 卡重复挂载/卸载
# 因为 ESP-IDF 的 VFS 层在注销时不减少 s_vfs_count 计数器
CONFIG_VFS_MAX_COUNT=16
CONFIG_FATFS_VOLUME_COUNT=4

# HTTP 服务器日志配置（隐藏连接重置警告）
CONFIG_HTTPD_LOG_PURGE_DATA=n

# 组件配置 - TianShanOS
# CONFIG_TS_CONFIG_ENABLE=y
# CONFIG_TS_LOG_ENABLE=y
# CONFIG_TS_EVENT_ENABLE=y
# CONFIG_TS_SERVICE_ENABLE=y
```
