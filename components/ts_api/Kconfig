## components/ts_api/Kconfig
```kconfig
menu "TianShanOS API Configuration"

    config TS_API_MAX_ENDPOINTS
        int "Maximum API endpoints"
        default 200
        range 32 512
        help
            Maximum number of API endpoints that can be registered.

    config TS_API_MAX_NAME_LENGTH
        int "Maximum API name length"
        default 64
        range 32 128
        help
            Maximum length of an API endpoint name.

    config TS_API_ENABLE_AUTH
        bool "Enable API authentication"
        default y
        help
            Enable authentication checking for API calls.

endmenu
```

## components/ts_cert/Kconfig
```kconfig
menu "TianShanOS PKI Certificate"

    config TS_CERT_ENABLED
        bool "Enable PKI certificate management"
        default y
        help
            Enable X.509 certificate and CSR management for mTLS.

    config TS_CERT_DEFAULT_ORG
        string "Default organization name for CSR"
        default "TianShanOS"
        depends on TS_CERT_ENABLED
        help
            Organization (O) field in certificate subject.

    config TS_CERT_DEFAULT_OU
        string "Default organizational unit for CSR"
        default "Device"
        depends on TS_CERT_ENABLED
        help
            Organizational Unit (OU) field in certificate subject.

    config TS_CERT_AUTO_INIT
        bool "Auto-initialize certificate component"
        default y
        depends on TS_CERT_ENABLED
        help
            Automatically initialize ts_cert during system startup.

    config TS_CERT_EXPIRY_WARNING_DAYS
        int "Certificate expiry warning threshold (days)"
        default 30
        range 7 365
        depends on TS_CERT_ENABLED
        help
            Number of days before certificate expiry to trigger warning.

endmenu
```

## components/ts_core/ts_log/Kconfig
```kconfig
menu "TianShanOS Logging"

    config TS_LOG_ENABLE
        bool "Enable TianShanOS Logging System"
        default y
        help
            Enable the TianShanOS logging system with multiple outputs.

    choice TS_LOG_DEFAULT_LEVEL
        prompt "Default log level"
        default TS_LOG_DEFAULT_LEVEL_INFO
        help
            Select the default log level.

        config TS_LOG_DEFAULT_LEVEL_NONE
            bool "None"
        config TS_LOG_DEFAULT_LEVEL_ERROR
            bool "Error"
        config TS_LOG_DEFAULT_LEVEL_WARN
            bool "Warning"
        config TS_LOG_DEFAULT_LEVEL_INFO
            bool "Info"
        config TS_LOG_DEFAULT_LEVEL_DEBUG
            bool "Debug"
        config TS_LOG_DEFAULT_LEVEL_VERBOSE
            bool "Verbose"
    endchoice

    config TS_LOG_DEFAULT_LEVEL
        int
        default 0 if TS_LOG_DEFAULT_LEVEL_NONE
        default 1 if TS_LOG_DEFAULT_LEVEL_ERROR
        default 2 if TS_LOG_DEFAULT_LEVEL_WARN
        default 3 if TS_LOG_DEFAULT_LEVEL_INFO
        default 4 if TS_LOG_DEFAULT_LEVEL_DEBUG
        default 5 if TS_LOG_DEFAULT_LEVEL_VERBOSE

    config TS_LOG_COLORS
        bool "Enable colored output"
        default y
        help
            Enable ANSI color codes in log output.

    config TS_LOG_TIMESTAMP
        bool "Include timestamp in logs"
        default y
        help
            Include timestamp in log messages.

    config TS_LOG_TASK_NAME
        bool "Include task name in logs"
        default y
        help
            Include FreeRTOS task name in log messages.

    menu "Log Outputs"

        config TS_LOG_OUTPUT_CONSOLE
            bool "Console output (UART)"
            default y
            help
                Enable console (UART) log output.

        config TS_LOG_OUTPUT_FILE
            bool "File output"
            default n
            help
                Enable file log output.

        config TS_LOG_FILE_PATH
            string "Log file path"
            default "/sdcard/logs"
            depends on TS_LOG_OUTPUT_FILE
            help
                Directory path for log files.

        config TS_LOG_FILE_MAX_SIZE
            int "Maximum log file size (KB)"
            default 1024
            range 64 10240
            depends on TS_LOG_OUTPUT_FILE
            help
                Maximum size of each log file in kilobytes.

        config TS_LOG_FILE_MAX_FILES
            int "Maximum number of log files"
            default 5
            range 1 20
            depends on TS_LOG_OUTPUT_FILE
            help
                Maximum number of log files to keep (rotation).

        config TS_LOG_OUTPUT_BUFFER
            bool "Memory buffer output"
            default y
            help
                Enable memory buffer for recent logs (useful for diagnostics and WebUI).

        config TS_LOG_BUFFER_SIZE
            int "Log buffer size (entries)"
            default 500
            range 50 5000
            depends on TS_LOG_OUTPUT_BUFFER
            help
                Number of recent log entries to keep in memory.
                Each entry uses ~300 bytes. 500 entries = ~150KB.
                With PSRAM, can increase to 2000+ for longer history.

        config TS_LOG_CAPTURE_ESP_LOG
            bool "Capture ESP_LOG output"
            default y
            depends on TS_LOG_OUTPUT_BUFFER
            help
                Install a vprintf hook to capture all ESP_LOG* output
                (ESP_LOGE, ESP_LOGW, ESP_LOGI, etc.) into the log buffer.
                This allows viewing all system logs via WebUI.

    endmenu

    config TS_LOG_TAG_MAX_LENGTH
        int "Maximum tag length"
        default 16
        range 8 32
        help
            Maximum length of log tags.

    config TS_LOG_MESSAGE_MAX_LENGTH
        int "Maximum message length"
        default 256
        range 64 1024
        help
            Maximum length of log messages.

endmenu
```

## components/ts_net/Kconfig
```kconfig
menu "TianShanOS Network Configuration"

    config TS_NET_ETHERNET_ENABLE
        bool "Enable Ethernet"
        default y
        help
            Enable Ethernet networking with W5500.

    config TS_NET_ETH_SPI_HOST
        int "Ethernet SPI Host"
        default 2
        depends on TS_NET_ETHERNET_ENABLE

    config TS_NET_WIFI_ENABLE
        bool "Enable WiFi"
        default y
        help
            Enable WiFi networking.

    config TS_NET_WIFI_AP_SSID
        string "WiFi AP SSID"
        default "TianShanOS"
        depends on TS_NET_WIFI_ENABLE

    config TS_NET_WIFI_AP_PASS
        string "WiFi AP Password"
        default "tianshan123"
        depends on TS_NET_WIFI_ENABLE

    config TS_NET_WIFI_AP_CHANNEL
        int "WiFi AP Channel"
        default 1
        range 1 13
        depends on TS_NET_WIFI_ENABLE

    config TS_NET_WIFI_AP_MAX_CONN
        int "WiFi AP Max Connections"
        default 4
        range 1 10
        depends on TS_NET_WIFI_ENABLE

    config TS_NET_DHCP_SERVER_ENABLE
        bool "Enable DHCP Server"
        default y

    config TS_NET_MDNS_ENABLE
        bool "Enable mDNS"
        default y
        help
            Enable mDNS for hostname.local discovery.
            Disabling saves ~4KB DRAM (task stack + data structures).

    config TS_NET_HTTP_SERVER_ENABLE
        bool "Enable HTTP Server"
        default y

    config TS_NET_HTTP_PORT
        int "HTTP Server Port"
        default 80
        depends on TS_NET_HTTP_SERVER_ENABLE

    config TS_NET_HTTPS_PORT
        int "HTTPS Server Port"
        default 443
        depends on TS_NET_HTTP_SERVER_ENABLE

endmenu
```

## components/ts_ota/Kconfig
```kconfig
menu "TianShanOS OTA Configuration"

    config TS_OTA_ENABLED
        bool "Enable OTA update support"
        default y
        help
            Enable Over-The-Air firmware update functionality.

    config TS_OTA_ROLLBACK_TIMEOUT
        int "Rollback timeout (seconds)"
        default 60
        range 10 300
        depends on TS_OTA_ENABLED
        help
            If the new firmware doesn't call ts_ota_mark_valid() within this
            time after boot, the system will automatically rollback to the
            previous firmware.

    config TS_OTA_HTTPS_ENABLED
        bool "Enable HTTPS OTA"
        default y
        depends on TS_OTA_ENABLED
        help
            Enable OTA updates from HTTPS URLs.

    config TS_OTA_SDCARD_ENABLED
        bool "Enable SD Card OTA"
        default y
        depends on TS_OTA_ENABLED
        help
            Enable OTA updates from SD card files.

    config TS_OTA_WEBUI_UPLOAD_ENABLED
        bool "Enable WebUI firmware upload"
        default y
        depends on TS_OTA_ENABLED
        help
            Enable firmware upload through WebUI.

    config TS_OTA_BUFFER_SIZE
        int "OTA buffer size (bytes)"
        default 4096
        range 1024 16384
        depends on TS_OTA_ENABLED
        help
            Buffer size for OTA data transfer.

    config TS_OTA_VERIFY_SIGNATURE
        bool "Verify firmware signature"
        default n
        depends on TS_OTA_ENABLED
        help
            Enable firmware signature verification using RSA-2048.
            Requires a valid public key to be embedded in the firmware.

    config TS_OTA_ANTI_ROLLBACK
        bool "Enable anti-rollback protection"
        default n
        depends on TS_OTA_ENABLED
        help
            Prevent downgrade to older firmware versions using eFuse counter.
            WARNING: This uses one-time programmable eFuse bits.

    config TS_OTA_VERSION_CHECK
        bool "Enable version check before update"
        default y
        depends on TS_OTA_ENABLED
        help
            Check firmware version before allowing update. Prevents
            accidental downgrade unless explicitly allowed.

    config TS_OTA_DEFAULT_URL
        string "Default OTA server URL"
        default "https://ota.example.com/tianshanos"
        depends on TS_OTA_HTTPS_ENABLED
        help
            Default URL for checking and downloading OTA updates.

    config TS_OTA_TASK_STACK_SIZE
        int "OTA task stack size"
        default 8192
        range 4096 16384
        depends on TS_OTA_ENABLED
        help
            Stack size for the OTA update task.

    config TS_OTA_TASK_PRIORITY
        int "OTA task priority"
        default 5
        range 1 24
        depends on TS_OTA_ENABLED
        help
            Priority for the OTA update task.

endmenu
```

## components/ts_storage/Kconfig
```kconfig
menu "TianShanOS Storage Configuration"

    config TS_STORAGE_ENABLE_SPIFFS
        bool "Enable SPIFFS support"
        default y
        help
            Enable SPIFFS filesystem for internal storage.

    config TS_STORAGE_SPIFFS_MOUNT_POINT
        string "SPIFFS mount point"
        default "/spiffs"
        depends on TS_STORAGE_ENABLE_SPIFFS
        help
            Mount point for SPIFFS filesystem.

    config TS_STORAGE_SPIFFS_PARTITION
        string "SPIFFS partition label"
        default "storage"
        depends on TS_STORAGE_ENABLE_SPIFFS
        help
            Partition label for SPIFFS.

    config TS_STORAGE_SPIFFS_MAX_FILES
        int "Maximum SPIFFS open files"
        default 5
        range 1 20
        depends on TS_STORAGE_ENABLE_SPIFFS
        help
            Maximum number of simultaneously open SPIFFS files.

    config TS_STORAGE_ENABLE_SD
        bool "Enable SD card support"
        default y
        help
            Enable SD card filesystem support.

    config TS_STORAGE_SD_MOUNT_POINT
        string "SD card mount point"
        default "/sdcard"
        depends on TS_STORAGE_ENABLE_SD
        help
            Mount point for SD card.

    config TS_STORAGE_SD_MAX_FREQ_KHZ
        int "SD card maximum frequency (kHz)"
        default 20000
        range 400 40000
        depends on TS_STORAGE_ENABLE_SD
        help
            Maximum frequency for SD card communication.

    choice TS_STORAGE_SD_MODE
        prompt "SD card interface mode"
        default TS_STORAGE_SD_MODE_SDIO_4BIT
        depends on TS_STORAGE_ENABLE_SD
        help
            Select SD card interface mode.

        config TS_STORAGE_SD_MODE_SPI
            bool "SPI mode"
        config TS_STORAGE_SD_MODE_SDIO_1BIT
            bool "SDIO 1-bit mode"
        config TS_STORAGE_SD_MODE_SDIO_4BIT
            bool "SDIO 4-bit mode"
    endchoice

    menu "SD Card GPIO Configuration"
        depends on TS_STORAGE_ENABLE_SD && !TS_STORAGE_SD_MODE_SPI

        config TS_STORAGE_SD_CMD_GPIO
            int "SD CMD GPIO"
            default 35
            range -1 48
            help
                GPIO for SD card CMD line. Set -1 to use slot default.

        config TS_STORAGE_SD_CLK_GPIO
            int "SD CLK GPIO"
            default 36
            range -1 48
            help
                GPIO for SD card CLK line. Set -1 to use slot default.

        config TS_STORAGE_SD_D0_GPIO
            int "SD D0 GPIO"
            default 37
            range -1 48
            help
                GPIO for SD card D0 line. Set -1 to use slot default.

        config TS_STORAGE_SD_D1_GPIO
            int "SD D1 GPIO"
            default 33
            range -1 48
            depends on TS_STORAGE_SD_MODE_SDIO_4BIT
            help
                GPIO for SD card D1 line (4-bit mode only).

        config TS_STORAGE_SD_D2_GPIO
            int "SD D2 GPIO"
            default 34
            range -1 48
            depends on TS_STORAGE_SD_MODE_SDIO_4BIT
            help
                GPIO for SD card D2 line (4-bit mode only).

        config TS_STORAGE_SD_D3_GPIO
            int "SD D3 GPIO"
            default 21
            range -1 48
            depends on TS_STORAGE_SD_MODE_SDIO_4BIT
            help
                GPIO for SD card D3 line (4-bit mode only).

    endmenu

endmenu
```
